/*
Accelerometer-based control for Human Augmentation Lab wrist roll
Max Luu
2/21/2019
*/

#include <Wire.h>
#include <SPI.h>
#include <Adafruit_LSM9DS1.h>
#include <Adafruit_Sensor.h> 

// i2c
Adafruit_LSM9DS1 lsm = Adafruit_LSM9DS1();

#define LSM9DS1_SCK A5
#define LSM9DS1_MISO 12
#define LSM9DS1_MOSI A4
#define LSM9DS1_XGCS 6
#define LSM9DS1_MCS 5


// Define the number of samples to keep track of. The higher the number, the
// more the readings will be smoothed, but the slower the output will respond to
// the input. Using a constant rather than a normal variable lets us use this
// value to determine the size of the readings array.
const int numReadings = 10;

int readings[numReadings];      // the readings from the analog input
int readIndex = 0;              // the index of the current reading
int total = 0;                  // the running total
int averageAcc = 0;             // the average acceleration

void setupSensor(){
  // 1.) Set the accelerometer range (we are using maximum of 2 gs, or 19.62m/s^2)
  lsm.setupAccel(lsm.LSM9DS1_ACCELRANGE_2G);
  //lsm.setupAccel(lsm.LSM9DS1_ACCELRANGE_4G);
  //lsm.setupAccel(lsm.LSM9DS1_ACCELRANGE_8G);
  //lsm.setupAccel(lsm.LSM9DS1_ACCELRANGE_16G);
  
  // 2.) Set the magnetometer sensitivity (we are using 4 gauss sensitivity)
  lsm.setupMag(lsm.LSM9DS1_MAGGAIN_4GAUSS);
  //lsm.setupMag(lsm.LSM9DS1_MAGGAIN_8GAUSS);
  //lsm.setupMag(lsm.LSM9DS1_MAGGAIN_12GAUSS);
  //lsm.setupMag(lsm.LSM9DS1_MAGGAIN_16GAUSS);

  // 3.) Setup the gyroscope (we are using a 245 degrees per second maximum)
  lsm.setupGyro(lsm.LSM9DS1_GYROSCALE_245DPS);
  //lsm.setupGyro(lsm.LSM9DS1_GYROSCALE_500DPS);
  //lsm.setupGyro(lsm.LSM9DS1_GYROSCALE_2000DPS);
}

void setup() {
  Serial.begin(115200);
  
  Serial.println("IMU data read begin");
  
  // Try to initialise and warn if we couldn't detect the chip
  if (!lsm.begin())
  {
    Serial.println("Unable to initialize IMU. Check  wiring");
    while (1);
  }
  Serial.println("Found IMU");

  // helper function to just set the default scaling
  setupSensor();
  for (int thisReading = 0; thisReading < numReadings; thisReading++) {
    readings[thisReading] = 0;
  }
}

void loop() {
  
  lsm.read();  /* ask it to read in the data */ 

  /* Get a new sensor event */ 
  sensors_event_t a, m, g, temp;

  lsm.getEvent(&a, &m, &g, &temp);
  
  // subtract the last reading:
  total = total - readings[readIndex];
  // read from the accelerometer
  readings[readIndex] = a.acceleration.y;
  // add the reading to the total
  total = total + readings[readIndex];
  // advance to the next position in the array
  readIndex = readIndex + 1;

  // if we're at the end of the array, wrap to beginning
  if (readIndex >= numReadings) {
    readIndex = 0; 
  }
  averageAcc = total / numReadings;
  ax = map (averageAcc, -17000, 17000, 0, 180) ; // accelerometer gives values from -17000 to 17000
  
  ax = ax * rotMultiplier; //multiply average acceleration by the constant to translate from upper arm to wrist

  Serial.println (ax);

  sg90.write (ax); // write the average accelerometer reading 
}
